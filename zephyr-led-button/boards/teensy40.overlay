#include <zephyr/dt-bindings/input/input-event-codes.h>

/ {
    gpio_keys {
        compatible = "gpio-keys";
        user_btn0: button-0 {
            label = "User BTN0";
            gpios = <&gpio1 11 (GPIO_PULL_UP | GPIO_ACTIVE_LOW)>;
            zephyr,code = <INPUT_KEY_0>;
        };
    };

    aliases {
        sw0 = &user_btn0;
    };
};
